## config/west.yml
```yaml
manifest:
  remotes:
    - name: moergo-sc
      url-base: https://github.com/moergo-sc
    - name: zmkfirmware
      url-base: https://github.com/zmkfirmware
    - name: urob
      url-base: https://github.com/urob
    - name: beekeeb
      url-base: https://github.com/beekeeb
    - name: petejohanson
      url-base: https://github.com/petejohanson
    - name: caksoylar
      url-base: https://github.com/caksoylar
  projects:
    - name: zmk
      remote: zmkfirmware
      revision: v0.3
      import: app/west.yml
    - name: zmk-helpers
      remote: urob
      revision: v0.3
    - name: zmk-auto-layer
      remote: urob
      revision: v0.3
    - name: zmk-keyboard-toucan
      remote: beekeeb
      revision: main
    - name: cirque-input-module
      remote: petejohanson
      revision: main
    - name: zmk-rgbled-widget
      remote: caksoylar
      revision: main
  self:
    path: config
```
